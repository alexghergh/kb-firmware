/*
 * Copyright (c) 2024 Alexandru Gherghescu (alexghergh@gmail.com)
 *
 * SPDX-License-Identifier: MIT
 */

#include "kyria_rev2_common.dtsi"

// nice!view CS is wired to D0 (P0.08); the adapter defaults to D1 (P0.06),
// which the kyria shield uses as the ws2812 underglow data; active-high matches
// the adapter's own cs-gpios convention, not the usual active-low spi cs; the
// override lives in this keymap file because &nice_view_spi only exists on the
// left build (nice_view_adapter shield, see build.yaml)
&nice_view_spi {
    cs-gpios = <&pro_micro 0 GPIO_ACTIVE_HIGH>;
};

// receiving end of the trackpad channel declared in kyria_rev2_common.dtsi;
// only the central half runs a listener
&glidepoint_listener {
    status = "okay";
};
